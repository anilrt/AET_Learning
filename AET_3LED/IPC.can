/*@!Encoding:1252*/
includes
{
  
}

variables
{
  
}

on message BCM_Message
{
  //putValue(Env_IPC,this.BCM_Signal);
  @Indicator::Sys_IPC = this.BCM_Signal;
}
